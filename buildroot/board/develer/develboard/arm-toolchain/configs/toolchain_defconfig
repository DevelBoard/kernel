## buildroot/board/develer/develboard/arm-toolchain/configs/toolchain_defconfig
```kconfig
BR2_arm=y
BR2_cortex_a5=y
BR2_ARM_EABIHF=y
BR2_ARM_ENABLE_NEON=y
BR2_ARM_FPU_VFPV4D16=y
BR2_KERNEL_HEADERS_3_18=y
BR2_TOOLCHAIN_BUILDROOT_GLIBC=y
BR2_TOOLCHAIN_BUILDROOT_CXX=y
BR2_INIT_NONE=y
BR2_ROOTFS_DEVICE_CREATION_STATIC=y
# BR2_TARGET_ENABLE_ROOT_LOGIN is not set
BR2_SYSTEM_BIN_SH_NONE=y
# BR2_TARGET_GENERIC_GETTY is not set
# BR2_TARGET_GENERIC_REMOUNT_ROOTFS_RW is not set
BR2_ROOTFS_POST_BUILD_SCRIPT="board/develer/develboard/arm-toolchain/extract-toolchain.sh"
# BR2_PACKAGE_BUSYBOX is not set
# BR2_TARGET_ROOTFS_TAR is not set
```

## buildroot/configs/develer_develboard_defconfig
```kconfig
BR2_arm=y
BR2_cortex_a5=y
BR2_ARM_EABIHF=y
BR2_ARM_ENABLE_NEON=y
BR2_ARM_FPU_VFPV4D16=y
BR2_TOOLCHAIN_EXTERNAL=y
BR2_TOOLCHAIN_EXTERNAL_CUSTOM=y
BR2_TOOLCHAIN_EXTERNAL_DOWNLOAD=y
BR2_TOOLCHAIN_EXTERNAL_URL="https://github.com/DevelBoard/toolchains/raw/blue/arm-buildroot-linux-gnueabihf.tar.gz"
BR2_TOOLCHAIN_EXTERNAL_GCC_4_9=y
BR2_TOOLCHAIN_EXTERNAL_HEADERS_3_18=y
BR2_TOOLCHAIN_EXTERNAL_CUSTOM_GLIBC=y
BR2_TOOLCHAIN_EXTERNAL_CXX=y
BR2_TARGET_TZ_INFO=y
BR2_ROOTFS_OVERLAY="board/develer/develboard/rootfs-overlay"
BR2_ROOTFS_POST_BUILD_SCRIPT="board/develer/develboard/post-build.sh"
BR2_LINUX_KERNEL=y
BR2_LINUX_KERNEL_CUSTOM_GIT=y
BR2_LINUX_KERNEL_CUSTOM_REPO_URL="https://github.com/linux4sam/linux-at91.git"
BR2_LINUX_KERNEL_CUSTOM_REPO_VERSION="linux4sam_4.7"
BR2_LINUX_KERNEL_PATCH="board/develer/develboard/linux-linux4sam_4.7-patches"
BR2_LINUX_KERNEL_USE_CUSTOM_CONFIG=y
BR2_LINUX_KERNEL_CUSTOM_CONFIG_FILE="board/develer/develboard/linux-linux4sam_4.7.config"
BR2_LINUX_KERNEL_ZIMAGE=y
BR2_LINUX_KERNEL_DTS_SUPPORT=y
BR2_LINUX_KERNEL_INTREE_DTS_NAME="at91-sama5d4_develboard at91-sama5d4_develboard_eva01 at91-sama5d4_develboard_eva01_r2 at91-sama5d4_develboard_eva01_r3"
BR2_PACKAGE_BUSYBOX_CONFIG="board/develer/develboard/busybox-1.23.1.config"
BR2_PACKAGE_BUSYBOX_SHOW_OTHERS=y
BR2_PACKAGE_DROPBEAR=y
BR2_PACKAGE_DROPBEAR_DISABLE_REVERSEDNS=y
BR2_TARGET_ROOTFS_TAR_GZIP=y
BR2_TARGET_AT91BOOTSTRAP3=y
BR2_TARGET_AT91BOOTSTRAP3_CUSTOM_GIT=y
BR2_TARGET_AT91BOOTSTRAP3_CUSTOM_REPO_URL="https://github.com/linux4sam/at91bootstrap.git"
BR2_TARGET_AT91BOOTSTRAP3_CUSTOM_REPO_VERSION="v3.7.2"
BR2_TARGET_AT91BOOTSTRAP3_CUSTOM_PATCH_DIR="board/develer/develboard/at91bootstrap-3.7.2-patches"
BR2_TARGET_AT91BOOTSTRAP3_USE_CUSTOM_CONFIG=y
BR2_TARGET_AT91BOOTSTRAP3_CUSTOM_CONFIG_FILE="board/develer/develboard/at91bootstrap-3.7.2.config"
BR2_TARGET_BAREBOX=y
BR2_TARGET_BAREBOX_CUSTOM_GIT=y
BR2_TARGET_BAREBOX_CUSTOM_GIT_REPO_URL="https://github.com/DevelBoard/barebox.git"
BR2_TARGET_BAREBOX_CUSTOM_GIT_VERSION="ed0f76edc"
BR2_TARGET_BAREBOX_BOARD_DEFCONFIG="develer_develboard"
BR2_TARGET_BAREBOX_BAREBOXENV=y
BR2_TARGET_BAREBOX_CUSTOM_ENV=y
BR2_TARGET_BAREBOX_CUSTOM_ENV_PATH="board/develer/develboard/barebox-2015.10.0-env"
```

## buildroot/package/genhostname/Config.in
```kconfig
config BR2_PACKAGE_GENHOSTNAME
        bool "genhostname"
        help
          Generates an hostname based on the MAC address of an ethernet
          interface on first boot.
```
